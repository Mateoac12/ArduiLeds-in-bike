const int srClear = 3; // SRCLR
const int srData = 4; // SER
const int srClock = 5;  // SRCLK
const int srLatch = 6; // RCLK
const int ledPin = 13;

//-------------------     VARIABLE LUCES     -------------------//

volatile int TipoDeMatriz = 0;

volatile int k=0;
volatile int i=0;
volatile int j=0;

//-------------------     TIEMPOS     -------------------//

const int Pinentrada = 2;
volatile long largador = 0;

volatile long tiempo=0;
volatile long tiempo1 = 0; 

unsigned long tiempoReal=0;
unsigned long tiempoAnterior=0;


//-------------------     SETUP      -------------------//

void setup () {

    Serial.begin(9600);
    pinMode(7,INPUT_PULLUP);
    attachInterrupt(0, nuevoTiempo, FALLING); 

    // put your setup code here, to run once:
    pinMode(ledPin,OUTPUT);
    pinMode(srClock,OUTPUT);  
    pinMode(srLatch,OUTPUT);  
    pinMode(srData,OUTPUT);
    pinMode(srClear,OUTPUT);
    digitalWrite(srClock,LOW);
    digitalWrite(srLatch,LOW);
    digitalWrite(srData,LOW);
}

//-------------------      LUCES     -------------------//


boolean data[24][24] ={{0, 0, 0, 0, 0, 0, 0, 0, 0, 0, 0, 0,    0, 0, 0, 0, 0, 0, 0, 0, 0, 0, 0, 0},
                       {0, 0, 0, 0, 0, 0, 0, 0, 0, 0, 0, 0,    0, 0, 0, 0, 0, 0, 0, 0, 0, 0, 0, 0},
                       {0, 0, 0, 0, 0, 0, 0, 0, 0, 0, 0, 0,    0, 0, 0, 0, 0, 0, 0, 0, 0, 0, 0, 0},
                       {0, 0, 0, 0, 0, 0, 0, 0, 0, 0, 0, 0,    0, 0, 0, 0, 0, 0, 0, 0, 0, 0, 0, 0},
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                       {0, 0, 0, 0, 0, 0, 0, 0, 0, 0, 0, 0,    0, 0, 0, 0, 0, 0, 0, 0, 0, 0, 0, 0}                  
};

boolean data1[24][24]={{0, 0, 0, 0, 0, 0, 0, 0, 0, 0, 0, 0,    0, 0, 0, 0, 0, 0, 0, 0, 0, 0, 0, 0},
                       {0, 0, 0, 0, 0, 0, 0, 0, 0, 0, 0, 0,    0, 0, 0, 0, 0, 0, 0, 0, 0, 0, 0, 0},
                       {0, 0, 0, 0, 0, 0, 0, 0, 0, 0, 0, 0,    0, 0, 0, 0, 0, 0, 0, 0, 0, 0, 0, 0},
                       {1, 1, 0, 0, 0, 0, 0, 0, 0, 0, 0, 0,    0, 0, 0, 0, 0, 0, 0, 0, 0, 0, 0, 0},
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                       {0, 0, 0, 0, 0, 0, 0, 0, 0, 0, 0, 0,    0, 0, 0, 0, 0, 0, 0, 0, 0, 0, 0, 0}                  
};

boolean data2[24][24]={{1, 1, 0, 0, 0, 0, 0, 0, 0, 0, 0, 0,    0, 0, 0, 0, 0, 0, 0, 0, 0, 0, 0, 0},
                       {1, 1, 1, 1, 0, 0, 0, 0, 0, 0, 0, 0,    0, 0, 0, 0, 0, 0, 0, 0, 0, 0, 0, 0},
                       {1, 1, 1, 1, 1, 1, 0, 0, 0, 0, 0, 0,    0, 0, 0, 0, 0, 0, 0, 0, 0, 0, 0, 0},
                       {0, 0, 1, 1, 1, 1, 1, 1, 0, 0, 0, 0,    0, 0, 0, 0, 0, 0, 0, 0, 0, 0, 0, 0},
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                       {1, 1, 0, 0, 0, 0, 0, 0, 0, 0, 0, 0,    0, 0, 0, 0, 0, 0, 0, 0, 0, 0, 0, 0}                  
};



//------------------- INTERRUPCION  -------------------//

void nuevoTiempo(){ 
  tiempo = micros();
  tiempo1=tiempo - tiempoAnterior;
  if ( tiempo1 > 100000){
  tiempoReal = tiempo1;

  tiempoAnterior = tiempo;  
      
    j=0;
    TipoDeMatriz++;
  } 
  }


  
void flancoSubida(int pin) {
  digitalWrite(pin,LOW);
  delayMicroseconds(10);
  digitalWrite(pin,HIGH);
  delayMicroseconds(10);
}

//-------------------      LOOP       -------------------//

void loop() {
  flancoSubida(srClear);

    if (TipoDeMatriz==7){
    TipoDeMatriz=0;
  }


  if (TipoDeMatriz<=2){
  for (int i = 0; i < 24; i++){  
    digitalWrite(srData,data[i][j]);
    if (i == 23){
      j++;
      if (j == 24){
        j = 0;
      }
    }
    delayMicroseconds(tiempoReal/24000); 
    flancoSubida(srClock);
  }
  }


  if (TipoDeMatriz>2 && TipoDeMatriz<=4){
  for (int i = 0; i < 24; i++){  
    digitalWrite(srData,data1[i][j]);
    if (i == 23){
      j++;
      if (j == 24){
        j = 0;
      }
    }
    delayMicroseconds(tiempoReal/24000); 
    flancoSubida(srClock);
  }
  }

  if (TipoDeMatriz>4 && TipoDeMatriz<=6){
  for (int i = 0; i < 24; i++){  
    digitalWrite(srData,data2[i][j]);
    if (i == 23){
      j++;
      if (j == 24){
        j = 0;
      }
    }
    delayMicroseconds(tiempoReal/24000); 
    flancoSubida(srClock);
  }
  }

  flancoSubida(srLatch);
}
